// SPDX-License-Identifier: BSD-3-Clause
/*
 * Xiaomi Raphael SMB1390 charge pump hardware description.
 * Board integration must enable i2c4 and the charge pump node together.
 */

#include <dt-bindings/iio/qcom,spmi-vadc.h>
#include <dt-bindings/interrupt-controller/irq.h>

&pm8150b_adc {
	channel@e {
		reg = <ADC5_AMUX_THM2>;
		qcom,hw-settle-time = <200>;
		qcom,pre-scaling = <1 1>;
		label = "smb1390_therm";
	};
};

&i2c4 {
	smb1390: charge-pump@10 {
		compatible = "qcom,smb1390-charger";
		reg = <0x10>;
		interrupt-parent = <&spmi_bus>;
		interrupts = <0x2 0xc5 0x0 IRQ_TYPE_LEVEL_LOW>;
		qcom,primary-charger = <&pm8150b_charger>;
		monitored-battery = <&battery>;
		status = "disabled";
	};
};
