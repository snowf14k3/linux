// SPDX-License-Identifier: BSD-3-Clause
/*
 * Camera evaluation alias for the enabled Raphael board wiring.
 * Front opens and capture still require valid motor/Hall endpoint calibration.
 * RAW and PIX capture and image quality require hardware validation.
 */
#include "sm8150-xiaomi-raphael.dts"

/ {
	model = "Xiaomi Redmi K20 Pro (RAW camera evaluation)";
};
