## Documentation/devicetree/bindings/iio/magnetometer/asahi-kasei,ak09970.yaml
```yaml
# SPDX-License-Identifier: (GPL-2.0-only OR BSD-2-Clause)
%YAML 1.2
---
$id: http://devicetree.org/schemas/iio/magnetometer/asahi-kasei,ak09970.yaml#
$schema: http://devicetree.org/meta-schemas/core.yaml#

title: Asahi Kasei AK09970 Hall magnetic position sensor

maintainers:
  - snowf14k3 <60956553+snowf14k3@users.noreply.github.com>

description: |
  The AK09970 reports magnetic measurements over I2C and signals data
  ready through an interrupt. On Raphael it observes the popup camera
  mechanism. Position thresholds depend on the assembled mechanism and
  are not defined by the sensor itself.

properties:
  compatible:
    const: asahi-kasei,ak09970

  reg:
    maxItems: 1

  interrupts-extended:
    maxItems: 1

  reset-gpios:
    maxItems: 1

  vdd-supply: true

  asahi-kasei,measure-freq-hz:
    enum: [10, 20, 50, 100]
    default: 100

  pinctrl-names:
    items:
      - const: default

  pinctrl-0: true

required:
  - compatible
  - reg
  - interrupts-extended
  - reset-gpios
  - vdd-supply

additionalProperties: false

examples:
  - |
    #include <dt-bindings/gpio/gpio.h>
    #include <dt-bindings/interrupt-controller/irq.h>
    i2c {
        #address-cells = <1>;
        #size-cells = <0>;

        hall-sensor@c {
            compatible = "asahi-kasei,ak09970";
            reg = <0x0c>;
            interrupts-extended = <&tlmm 27 IRQ_TYPE_EDGE_FALLING>;
            reset-gpios = <&tlmm 11 GPIO_ACTIVE_LOW>;
            vdd-supply = <&vreg_l8c_1p8>;
            asahi-kasei,measure-freq-hz = <100>;
        };
    };
...
```

## Documentation/devicetree/bindings/media/i2c/dongwoon,dw9763.yaml
```yaml
# SPDX-License-Identifier: (GPL-2.0-only OR BSD-2-Clause)
%YAML 1.2
---
$id: http://devicetree.org/schemas/media/i2c/dongwoon,dw9763.yaml#
$schema: http://devicetree.org/meta-schemas/core.yaml#

title: Dongwoon DW9763 voice coil lens actuator

maintainers:
  - snowf14k3 <60956553+snowf14k3@users.noreply.github.com>

description:
  The DW9763 is a 10-bit I2C voice coil actuator. On Xiaomi Raphael,
  the main and telephoto modules connect it to separate CCI buses and
  switch a dedicated 2.8 V actuator supply for each module.

properties:
  compatible:
    const: dongwoon,dw9763

  reg:
    maxItems: 1

  vin-supply:
    description: 1.8 V I2C interface supply shared with the camera module.

  vdd-supply:
    description: 2.8 V actuator supply.

required:
  - compatible
  - reg
  - vin-supply
  - vdd-supply

additionalProperties: false

examples:
  - |
    i2c {
        #address-cells = <1>;
        #size-cells = <0>;

        camera-lens@c {
            compatible = "dongwoon,dw9763";
            reg = <0x0c>;
            vin-supply = <&camera_vio>;
            vdd-supply = <&camera_main_vaf>;
        };
    };
...
```

## Documentation/devicetree/bindings/media/i2c/xiaomi,raphael-sensors.yaml
```yaml
# SPDX-License-Identifier: (GPL-2.0 OR BSD-2-Clause)
%YAML 1.2
---
$id: http://devicetree.org/schemas/media/i2c/xiaomi,raphael-sensors.yaml#
$schema: http://devicetree.org/meta-schemas/core.yaml#

title: Xiaomi Raphael IMX586, OV8856, S5K3L6 and S5K3T2 image sensors

maintainers:
  - snowf14k3 <60956553+snowf14k3@users.noreply.github.com>

description:
  Camera modules connected to the SM8150 CAMSS on Xiaomi Raphael.
  The modules use a 19.2 MHz input clock and four CSI-2 D-PHY lanes.

allOf:
  - $ref: /schemas/media/video-interface-devices.yaml#
  - if:
      properties:
        compatible:
          const: sony,imx586
    then:
      required:
        - custom1-supply
    else:
      properties:
        custom1-supply: false

  - if:
      properties:
        compatible:
          const: samsung,s5k3t2
    then:
      required:
        - popup-motor
    else:
      properties:
        popup-motor: false

properties:
  compatible:
    enum:
      - sony,imx586
      - xiaomi,raphael-ov8856
      - samsung,s5k3l6
      - samsung,s5k3t2

  reg:
    maxItems: 1

  clocks:
    maxItems: 1

  clock-names:
    const: xvclk

  aux-supply:
    description:
      Shared 3.1 V module support rail from PM8150 L17. CamX calls this
      CUSTOM_REG2 for IMX586 and CUSTOM_REG1 for the other modules.

  avdd-supply:
    description: Analog supply.

  dvdd-supply:
    description: Digital core supply.

  dovdd-supply:
    description: Digital interface supply.

  custom1-supply:
    description: Additional IMX586 module supply from PM8150 S5.

  reset-gpios:
    maxItems: 1
    description: Active-low sensor reset input.

  popup-motor:
    $ref: /schemas/types.yaml#/definitions/phandle
    description:
      Calibrated popup interlock for the S5K3T2 front module. Opening its
      subdevice, including inspection-only opens, holds the camera extended.
      Streaming also holds the interlock until the sensor has stopped.

  flash-leds: true
  lens-focus: true

  orientation: true
  rotation: true

  port:
    $ref: /schemas/graph.yaml#/$defs/port-base
    additionalProperties: false
    properties:
      endpoint:
        $ref: /schemas/media/video-interfaces.yaml#
        unevaluatedProperties: false
        properties:
          data-lanes:
            items:
              - const: 1
              - const: 2
              - const: 3
              - const: 4
        required:
          - data-lanes
          - link-frequencies

required:
  - compatible
  - reg
  - clocks
  - aux-supply
  - avdd-supply
  - dvdd-supply
  - dovdd-supply
  - reset-gpios
  - port

additionalProperties: false
```

## Documentation/devicetree/bindings/media/qcom,sm8150-camss.yaml
```yaml
# SPDX-License-Identifier: (GPL-2.0 OR BSD-2-Clause)
%YAML 1.2
---
$id: http://devicetree.org/schemas/media/qcom,sm8150-camss.yaml#
$schema: http://devicetree.org/meta-schemas/core.yaml#

title: Qualcomm SM8150 Camera Subsystem (CAMSS)

maintainers:
  - snowf14k3 <60956553+snowf14k3@users.noreply.github.com>

description:
  SM8150 Titan 175 camera front end with four CSIPHY receivers, four CSI
  decoders, two full image front ends and two lite image front ends.

properties:
  compatible:
    const: qcom,sm8150-camss

  reg:
    minItems: 12
    maxItems: 12

  reg-names:
    items:
      - const: csiphy0
      - const: csiphy1
      - const: csiphy2
      - const: csiphy3
      - const: csid0
      - const: csid1
      - const: csid2
      - const: csid3
      - const: vfe0
      - const: vfe1
      - const: vfe_lite0
      - const: vfe_lite1

  interrupts:
    minItems: 12
    maxItems: 12

  interrupt-names:
    items:
      - const: csiphy0
      - const: csiphy1
      - const: csiphy2
      - const: csiphy3
      - const: csid0
      - const: csid1
      - const: csid2
      - const: csid3
      - const: vfe0
      - const: vfe1
      - const: vfe_lite0
      - const: vfe_lite1

  clocks:
    minItems: 29
    maxItems: 29

  clock-names:
    items:
      - const: cam_ahb
      - const: cam_hf_axi
      - const: cam_sf_axi
      - const: camnoc_axi
      - const: camnoc_axi_src
      - const: cpas_ahb
      - const: slow_ahb_src
      - const: csiphy0
      - const: csiphy0_timer
      - const: csiphy1
      - const: csiphy1_timer
      - const: csiphy2
      - const: csiphy2_timer
      - const: csiphy3
      - const: csiphy3_timer
      - const: vfe0
      - const: vfe0_axi
      - const: vfe0_cphy_rx
      - const: vfe0_csid
      - const: vfe1
      - const: vfe1_axi
      - const: vfe1_cphy_rx
      - const: vfe1_csid
      - const: vfe_lite0
      - const: vfe_lite0_cphy_rx
      - const: vfe_lite0_csid
      - const: vfe_lite1
      - const: vfe_lite1_cphy_rx
      - const: vfe_lite1_csid

  power-domains:
    minItems: 3
    maxItems: 3

  power-domain-names:
    items:
      - const: ife0
      - const: ife1
      - const: top

  vdd-csiphy-1p2-supply:
    description: 1.2 V CSI PHY supply.

  iommus:
    minItems: 8
    maxItems: 8

  interconnects:
    minItems: 4
    maxItems: 4

  interconnect-names:
    items:
      - const: cam_ahb
      - const: cam_hf_0_mnoc
      - const: cam_hf_1_mnoc
      - const: cam_sf_0_mnoc

  ports:
    $ref: /schemas/graph.yaml#/properties/ports
    description: CSI inputs corresponding to CSIPHY 0 through 3.
    patternProperties:
      "^port@[0-3]$":
        $ref: /schemas/graph.yaml#/$defs/port-base
        unevaluatedProperties: false
        properties:
          endpoint:
            $ref: video-interfaces.yaml#
            unevaluatedProperties: false
            properties:
              data-lanes:
                minItems: 1
                maxItems: 4
            required:
              - data-lanes

required:
  - compatible
  - reg
  - reg-names
  - interrupts
  - interrupt-names
  - clocks
  - clock-names
  - power-domains
  - power-domain-names
  - vdd-csiphy-1p2-supply
  - iommus
  - interconnects
  - interconnect-names

additionalProperties: false
```

## Documentation/devicetree/bindings/misc/ti,drv8846.yaml
```yaml
# SPDX-License-Identifier: (GPL-2.0-only OR BSD-2-Clause)
%YAML 1.2
---
$id: http://devicetree.org/schemas/misc/ti,drv8846.yaml#
$schema: http://devicetree.org/meta-schemas/core.yaml#

title: TI DRV8846 stepper motor in the Xiaomi Raphael popup camera

maintainers:
  - snowf14k3 <60956553+snowf14k3@users.noreply.github.com>

description: |
  The Raphael board uses a DRV8846 with a PM8150L PWM step clock and
  GPIO control lines. The fault input is active low. The motor driver
  applies a bounded three-stage pulse sequence and leaves the bridge
  asleep and unpowered whenever idle.

properties:
  compatible:
    const: ti,drv8846

  pwms:
    maxItems: 1

  mode0-gpios:
    maxItems: 1

  mode1-gpios:
    maxItems: 1

  dir-gpios:
    maxItems: 1

  sleep-gpios:
    maxItems: 1

  enable-gpios:
    maxItems: 1

  fault-gpios:
    maxItems: 1

  ti,rampup-period-ns:
    minimum: 50000
    maximum: 1000000

  ti,high-period-ns:
    minimum: 50000
    maximum: 1000000

  ti,rampdown-period-ns:
    minimum: 50000
    maximum: 1000000

  ti,rampup-duration-ms:
    minimum: 1
    maximum: 1500

  ti,high-duration-ms:
    minimum: 1
    maximum: 1500

  ti,rampdown-duration-ms:
    minimum: 1
    maximum: 1500

  ti,step-mode:
    enum: [0, 1, 2, 3]

  pinctrl-names:
    items:
      - const: default

  pinctrl-0: true

required:
  - compatible
  - pwms
  - mode0-gpios
  - mode1-gpios
  - dir-gpios
  - sleep-gpios
  - enable-gpios
  - fault-gpios

additionalProperties: false

examples:
  - |
    #include <dt-bindings/gpio/gpio.h>
    motor {
        compatible = "ti,drv8846";
        pwms = <&pwm 4 1000000>;
        mode0-gpios = <&tlmm 21 GPIO_ACTIVE_HIGH>;
        mode1-gpios = <&tlmm 33 GPIO_ACTIVE_HIGH>;
        dir-gpios = <&tlmm 9 GPIO_ACTIVE_HIGH>;
        sleep-gpios = <&tlmm 35 GPIO_ACTIVE_HIGH>;
        enable-gpios = <&tlmm 130 GPIO_ACTIVE_HIGH>;
        fault-gpios = <&tlmm 36 GPIO_ACTIVE_LOW>;
    };
...
```

## Documentation/devicetree/bindings/nvmem/xiaomi,raphael-camera-eeprom.yaml
```yaml
# SPDX-License-Identifier: (GPL-2.0-only OR BSD-2-Clause)
%YAML 1.2
---
$id: http://devicetree.org/schemas/nvmem/xiaomi,raphael-camera-eeprom.yaml#
$schema: http://devicetree.org/meta-schemas/core.yaml#

title: Xiaomi Raphael camera module raw EEPROM

maintainers:
  - snowf14k3 <60956553+snowf14k3@users.noreply.github.com>

description: |
  Raphael has four camera module EEPROMs with 16-bit offsets and 8-bit
  data. Each needs camera VIO and a 19.2 MHz MCLK while reading; the
  main and telephoto modules also need their actuator VAF rail. The
  contents are exposed as opaque, read-only NVMEM bytes. The matching image
  sensor owns the shared MCLK pinmux and must be bound before EEPROM reads.

allOf:
  - $ref: nvmem.yaml#

properties:
  compatible:
    const: xiaomi,raphael-camera-eeprom

  reg:
    maxItems: 1

  size:
    $ref: /schemas/types.yaml#/definitions/uint32
    description: Raw byte span recorded by the camera module data.
    enum: [7158, 8040, 8192]

  vio-supply: true

  vaf-supply: true

  clocks:
    maxItems: 1

  clock-names:
    const: mclk

  assigned-clocks:
    maxItems: 1

  assigned-clock-rates:
    items:
      - const: 19200000

required:
  - compatible
  - reg
  - size
  - vio-supply
  - clocks
  - clock-names
  - assigned-clocks
  - assigned-clock-rates
  - read-only

unevaluatedProperties: false

examples:
  - |
    #include <dt-bindings/clock/qcom,sm8150-camcc.h>

    i2c {
        #address-cells = <1>;
        #size-cells = <0>;

        eeprom@58 {
            compatible = "xiaomi,raphael-camera-eeprom";
            reg = <0x58>;
            size = <8192>;
            vio-supply = <&camera_vio>;
            vaf-supply = <&camera_main_vaf>;
            clocks = <&camcc CAM_CC_MCLK0_CLK>;
            clock-names = "mclk";
            assigned-clocks = <&camcc CAM_CC_MCLK0_CLK_SRC>;
            assigned-clock-rates = <19200000>;
            read-only;
        };
    };

...
```

## Documentation/devicetree/bindings/power/supply/qcom,pm8150b-fg.yaml
```yaml
# SPDX-License-Identifier: (GPL-2.0-only OR BSD-2-Clause)
%YAML 1.2
---
$id: http://devicetree.org/schemas/power/supply/qcom,pm8150b-fg.yaml#
$schema: http://devicetree.org/meta-schemas/core.yaml#

title: Qualcomm PM8150B Gen4 fuel gauge

maintainers:
  - snowf14k3 <60956553+snowf14k3@users.noreply.github.com>

description:
  The optional DMA SRAM path reads battery temperature after programming
  board-specific thermistor coefficients. It requires the battery-missing
  interrupt and remains disabled unless qcom,fg-gen4-dma is present.

properties:
  compatible:
    const: qcom,pm8150b-fg

  reg:
    maxItems: 1

  interrupts:
    minItems: 1
    maxItems: 2

  interrupt-names:
    minItems: 1
    maxItems: 2
    items:
      - const: soc-delta
      - const: batt-missing

  monitored-battery: true

  power-supplies:
    maxItems: 1

  qcom,fg-gen4-dma:
    type: boolean
    description: Enable the PM8150B Gen4 DMA SRAM and calibrated temperature path.

  qcom,fg-therm-coefficients:
    $ref: /schemas/types.yaml#/definitions/uint32-array
    minItems: 5
    maxItems: 5
    items:
      minimum: 0
      maximum: 65535
    description: Five board battery thermistor coefficients in SRAM word order.

  qcom,fg-therm-center-offset:
    $ref: /schemas/types.yaml#/definitions/uint32
    maximum: 255
    description: Battery thermistor center offset in SRAM word 3.

  qcom,fg-therm-pull-up-kohms:
    $ref: /schemas/types.yaml#/definitions/uint32
    enum: [30, 100, 400]
    description: Battery thermistor pull-up resistance in kilohms.

required:
  - compatible
  - reg
  - interrupts
  - interrupt-names

allOf:
  - $ref: power-supply.yaml#
  - if:
      required:
        - qcom,fg-gen4-dma
    then:
      properties:
        interrupts:
          minItems: 2
        interrupt-names:
          minItems: 2
      required:
        - qcom,fg-therm-coefficients
        - qcom,fg-therm-center-offset
        - qcom,fg-therm-pull-up-kohms

additionalProperties: false

examples:
  - |
    #include <dt-bindings/interrupt-controller/irq.h>

    pmic {
        #address-cells = <1>;
        #size-cells = <0>;

        fuel-gauge@4000 {
            compatible = "qcom,pm8150b-fg";
            reg = <0x4000>;
            interrupts = <0x2 0x40 0x3 IRQ_TYPE_EDGE_RISING>;
            interrupt-names = "soc-delta";
        };
    };
...
```
