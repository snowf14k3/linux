## Documentation/devicetree/bindings/power/supply/qcom,smb1390.yaml
```yaml
# SPDX-License-Identifier: GPL-2.0-only OR BSD-2-Clause
%YAML 1.2
---
$id: http://devicetree.org/schemas/power/supply/qcom,smb1390.yaml#
$schema: http://devicetree.org/meta-schemas/core.yaml#

title: Qualcomm SMB1390 auxiliary charge pump

maintainers:
  - snowf14k3 <60956553+snowf14k3@users.noreply.github.com>

description: |
  The SMB1390 is an I2C-controlled divide-by-two charge pump. The driver
  exposes its fault state, switcher status and die temperature. Enabling the
  pump requires a coordinated charger and USB input policy.

allOf:
  - $ref: power-supply.yaml#
  - if:
      required:
        - qcom,pps-charge-pump-policy
    then:
      properties:
        io-channels:
          minItems: 3
        io-channel-names:
          minItems: 3

properties:
  compatible:
    const: qcom,smb1390

  reg:
    maxItems: 1

  interrupts:
    maxItems: 1

  interrupt-names:
    items:
      - const: fault

  io-channels:
    minItems: 1
    maxItems: 3
    items:
      - description: SMB1390 die monitor
      - description: USB connector thermistor
      - description: Handset skin thermistor

  io-channel-names:
    minItems: 1
    maxItems: 3
    items:
      - const: die-temp
      - const: connector-temp
      - const: skin-temp

  usb-pd-supply:
    $ref: /schemas/types.yaml#/definitions/phandle
    description: TCPM power supply controlling the USB PD contract.

  main-charger-supply:
    $ref: /schemas/types.yaml#/definitions/phandle
    description: PM8150B charger power supply feeding the battery.

  battery-supply:
    $ref: /schemas/types.yaml#/definitions/phandle
    description: PM8150B fuel gauge providing battery state and temperature.

  qcom,pps-charge-pump-policy:
    type: boolean
    description: |
      Enable autonomous PPS charge pump control with battery, input and
      switcher fault checks. Requires all supply references and the fault IRQ.

  qcom,max-input-current-microamp:
    $ref: /schemas/types.yaml#/definitions/uint32
    minimum: 1500000
    maximum: 2800000
    multipleOf: 50000
    description: Conservative USB input current cap used by the PPS policy.

dependencies:
  usb-pd-supply: [main-charger-supply, battery-supply, interrupts,
                  interrupt-names]
  main-charger-supply: [usb-pd-supply, battery-supply]
  battery-supply: [usb-pd-supply, main-charger-supply]
  interrupts: [interrupt-names]
  interrupt-names: [interrupts]
  qcom,pps-charge-pump-policy: [usb-pd-supply, main-charger-supply,
                                battery-supply, interrupts, interrupt-names,
                                qcom,max-input-current-microamp]

required:
  - compatible
  - reg
  - io-channels
  - io-channel-names

unevaluatedProperties: false

examples:
  - |
    #include <dt-bindings/iio/qcom,spmi-vadc.h>

    i2c {
      #address-cells = <1>;
      #size-cells = <0>;

      charge-pump@10 {
        compatible = "qcom,smb1390";
        reg = <0x10>;
        io-channels = <&pm8150b_adc ADC5_AMUX_THM2>;
        io-channel-names = "die-temp";
      };
    };
```
